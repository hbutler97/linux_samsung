## drivers/gpu/drm/exynos/Kconfig
```kconfig
config DRM_EXYNOS
	tristate "DRM Support for Samsung SoC EXYNOS Series"
	depends on OF && DRM
	select DRM_KMS_HELPER
	select DRM_KMS_FB_HELPER
	select FB_CFB_FILLRECT
	select FB_CFB_COPYAREA
	select FB_CFB_IMAGEBLIT
	select VIDEOMODE_HELPERS
	help
	  Choose this option if you have a Samsung SoC EXYNOS chipset.
	  If M is selected the module will be called exynosdrm.

if DRM_EXYNOS

config DRM_EXYNOS_DECON
	bool "DECON on Exynos"
	help
	  Choose this option if you want to use Exynos DECON for DRM.

comment "Encoders and Bridges"

config DRM_EXYNOS_DSI
	bool "MIPI-DSI host"
	depends on DRM_EXYNOS_FIMD || DRM_EXYNOS_DECON
	select DRM_MIPI_DSI
	select DRM_PANEL
	default n
	help
	  This enables support for Exynos MIPI-DSI device.

config DRM_EXYNOS_HDMI
	bool "HDMI driver"
	depends on DRM_EXYNOS_FIMD || DRM_EXYNOS_DECON
	default n
	help
	  Enable HDMI driver.

config DRM_EXYNOS_MAIN_LCD_BYPASS
	bool "Enable Main LCD Bypass"
	depends on DRM_EXYNOS_DSI
	default n
	help
	  Enable main display bypass when LCD is disconnected or broken
endif
```

## drivers/media/platform/exynos/fimc-is2/vendor/Kconfig
```kconfig
config VENDER_FEATURE
        bool "Use vendor specific features"
        depends on VIDEO_EXYNOS_FIMC_IS2
        default y
        help
          Use the vender specfic features.

config VENDER_DEFAULT
        bool "Use DEFAULT vender"
        depends on VENDER_FEATURE
        default n
        help
          Default.

source "drivers/media/platform/exynos/fimc-is2/vendor/default/Kconfig"
```

## drivers/misc/board/Kconfig
```kconfig
comment "Samsung Board Specific Drivers"
menuconfig BOARD_DRIVERS
	bool "Samsung Board Specific Drivers"
	default n

config BT_BCM89359
	bool "Broadcom BCM89359 support"
	default n
	depends on BOARD_DRIVERS
```

## drivers/misc/drvr/Kconfig
```kconfig
config EXYNOS_ADI_IF_2
	bool "Samsung Shared memory Interface for ADI 2"
	default y
	---help---
	  Samsung Shared Memory Interface for ADI from Eric 
```

## drivers/misc/mcu_ipc/Kconfig
```kconfig
#
# MCU_IPC Device Driver
#

config MCU_IPC
     bool "MCU IPC Support"
     default n
	 help
	   This enables MCU_IPC driver to control the MCU_IPC Device.

	   MCU_IPC is the Mailbox which has 16 interrupts for TX/RX each
	   and 256 bytes memory for communicating messages.
	   AP and CP can share the messages through this device.

config MCU_IPC_TEST
     bool "MCU_IPC driver test"
     depends on MCU_IPC
     help
	This enables MCU_IPC_TEST for checking mailbox at probe time.
```

## drivers/muic/Kconfig
```kconfig
#
# MUIC devices
#

comment "MUIC configs"

config USE_MUIC
	bool "Using MUIC device driver"
	depends on I2C
	default n
	help
	  If you say yes here you will get support for
	  the MUIC device driver.

config USE_SAFEOUT
	bool "Using SAFEOUT device driver"
	depends on I2C
	default n
	help
	  If you say yes here you will get support for
	  the SAFEOUT device driver.

config MUIC_NOTIFIER
	bool "MUIC notifier support"
	depends on USE_MUIC
	default n
	help
	  If you say yes here you will get support for
	  the MUIC attached device status change notification.

config MUIC_SYSFS
	bool "MUIC sysfs support"
	default n
	depends on MUIC_NOTIFIER
	help
	  'sysfs 'muic' directory create.

config SAMSUNG_MUIC
	bool "Using samsung MUIC chip driver"
	depends on USE_MUIC
	default n
	help
	  If you say yes here you will get support for the MUIC chip.

config MUIC_ADCMODE_SWITCH_WA
	bool "Using MUIC chip ADC Mode change W/A"
	depends on USE_MUIC
	default n
	help
	  This feature is for MUIC chip's ADC Mode change
	  chip bug Workaround.

config MUIC_RUSTPROOF_ON_USER
	bool "Using MUIC chip Rustproof function ON for User binary"
	depends on USE_MUIC
	default n
	help
	  This feature is for MUIC chip's Rustproof function.

config MUIC_TSU6721
	bool "Using TSU6721 MUIC"
	depends on USE_MUIC
	default n
	help
	  If you say yes here you will get support for
	  the TSU6721 MUIC chip.
```
